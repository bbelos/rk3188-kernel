## drivers/input/netupdate/Kconfig
```kconfig
menuconfig ENCRYPTION_DEVICE
	tristate "encryption support"
	default n
	depends on INPUT
	help
	  Enable this to be able to choose the drivers for controlling the
	  infrared on some platforms, for example on PDAs.

config ATXX_DEVICE_TYPE
	int "Select ATXX type"
	default 18
    depends on ENCRYPTION_DEVICE
	help
	  Select a type for ATXX, like 18/28/38.
```

## drivers/input/touchscreen/ICN850X/Kconfig
```kconfig
config TOUCHSCREEN_CHIPONE
	tristate "Chipone touchscreen"
	help
	  This enables support for Chipone touchscreens.
	  

config TOUCHSCREEN_ICN83XX
	tristate "Chipone touchscreen icn83xx"
	help
	  This enables support for Chipone touchscreens.	  
```

## drivers/net/wireless/nmi/Kconfig
```kconfig
config NMC1XXX_WIFI_MODULE
#        depends on AM_WIFI_SD_MMC || SD_MMC && SDIO
        tristate "Newportmedia NMC1XXX wireless cards support"
        select WIRELESS_EXT
        select WEXT_PRIV
        ---help---
          This module adds support for wireless adapters based on
          Broadcom NMC1000 chipset.

choice
    depends on NMC1XXX_WIFI_MODULE
    prompt "Wi-Fi chipset type"
    default NMC1000_WIFI_CHIP

	config NMC1000_WIFI_CHIP
	    bool "NMC1000 without bluetooth"
	config NMC1100_WIFI_CHIP
	    bool "NMC1100 with bluetooth"

endchoice

choice
    depends on NMC1XXX_WIFI_MODULE
    prompt "Wi-Fi bus type"
    default NMC1XXX_USE_SDIO
    
	config NMC1XXX_USE_SDIO_BUS
	    bool "communication by SDIO"
#	    depends on AM_WIFI_SD_MMC || SD_MMC && SDIO
	config NMC1XXX_USE_SPI_BUS
	    bool "communication by SPI"
endchoice

choice
		depends on NMC1XXX_WIFI_MODULE
		prompt "Memory Allocation"
		default NMC1XXX_PREALLOCATE_DURING_SYSTEM_BOOT
		
		config NMC1XXX_PREALLOCATE_DURING_SYSTEM_BOOT
		bool "Preallocate memory pool during system boot"
		
		config NMC1XXX_PREALLOCATE_AT_LOADING_DRIVER
		bool "Preallocate memory at loading driver"
		
		config NMC1XXX_DYNAMICALLY_ALLOCATE_MEMROY
		bool "Dynamically allocate memory in real time"
endchoice

config SDIO_HARD_IRQ
        depends on NMC1XXX_WIFI_MODULE && NMC1XXX_USE_SDIO
        bool "SDIO HARD IRQ"
        default n
        ---help---
          hard irq wake up polling process

config BK3515A_COMBO
        depends on NMC1XXX_WIFI_MODULE
        bool "Combo with bk3515"
        default y
        ---help---
          combo with bk3515

#config NMC1XXX_WIFI_CONTROL_FUNC
#        bool "Use NMC1XXX_wlan device"
#        depends on NMC1XXX_WIFI_MODULE
#        default n
#        ---help---
#           Use this option to get various parameters from architecture specific
#           NMC1XXX_wlan platform device. Say n if unsure.

config NMC1XXX_HW_OOB_INTR
        bool "Use out of band interrupt"
        depends on NMC1XXX_WIFI_MODULE && NMC1XXX_USE_SDIO_BUS
        default n
        ---help---
           Use out of band interrupt for wake on wireless.

#config NMC1XXX_OOB_INTR_ONLY
#        bool "Use out of band interrupt only"
#        depends on NMC1XXX_WIFI_MODULE && NMC1XXX_USE_SDIO_BUS
#        default n
#        ---help---
#           Use out of band interrupt for all interrupts(including SDIO interrupts).

config NMC1XXX_ENABLE_DEBUGFS
	bool "Export debugfs for NMC1XXX status"
	depends on NMC1XXX_WIFI_MODULE
	default n
	---help---
	   Export status information via debugfs.
```

## drivers/net/wireless/nmi/src/NMI_OsWrapper/OsKconfig/Kconfig
```kconfig
menu "THREADS"

config NMI_THREAD_FEATURE
	boolean "Enable Using Threads"

config NMI_THREAD_SUSPEND_CONTROL
	boolean "Enable Suspending Thread"
	depends on NMI_THREAD_FEATURE

config NMI_THREAD_STRICT_PRIORITY
	boolean "Enable Setting Thread Priority"
	depends on NMI_THREAD_FEATURE

endmenu

menu "SEMAPHORES"

config NMI_SEMAPHORE_FEATURE
	boolean "Enable Using Semaphores"

config NMI_SEMAPHORE_TIMEOUT
	boolean "Enable Semaphore Timeout"
	depends on NMI_SEMAPHORE_FEATURE

endmenu

menu "SLEEP"

config NMI_SLEEP_FEATURE
	boolean "Enable Using Sleep"

config NMI_SLEEP_HI_RES
	boolean "Enable High Resolution Sleep"
	depends on NMI_SLEEP_FEATURE

endmenu

menu "TIMER"

config NMI_TIMER_FEATURE
	boolean "Enable Using Timer"
	
config NMI_TIMER_PERIODIC
	boolean "Enable periodic Timer support"
	depends on NMI_TIMER_FEATURE

endmenu

menu "MEMORY"

config NMI_MEMORY_FEATURE
	boolean "Enable dynamic memory management"

config NMI_MEMORY_POOLS
	boolean "Enable memory manager pools"
	depends on NMI_MEMORY_FEATURE

config NMI_MEMORY_DEBUG
	boolean "Enable memory debugging and tracing (could be heavy wieght)"
	depends on NMI_MEMORY_FEATURE

endmenu

menu "ASSERSIONS"

config NMI_ASSERTION_SUPPORT
	boolean "Enable assertions"
	
endmenu

menu "Utilities"

config NMI_STRING_UTILS
	boolean "Enable String standard utilities (usually found in string.h)"

endmenu

menu "Message Queue"

config NMI_MSG_QUEUE_FEATURE
	boolean "Enable Message Queues"

config NMI_MSG_QUEUE_IPC_NAME
	boolean "Enable IPC communications via named message queues"
	depends on NMI_MSG_QUEUE_FEATURE

config NMI_MSG_QUEUE_TIMEOUT
	boolean "Enable Message Queue timeout"
	depends on NMI_MSG_QUEUE_FEATURE

endmenu

menu "File operations"

config NMI_FILE_OPERATIONS_FEATURE
	boolean "Enable File operations"

config NMI_FILE_OPERATIONS_STRING_API
	boolean "Enable API to read/write strings to files"
	depends on NMI_FILE_OPERATIONS_FEATURE

endmenu

menu "Events"

config NMI_EVENT_FEATURE
	boolean "Enable Event objects"

config NMI_EVENT_TIMEOUT
	boolean "Enable Event timeout"
	depends on NMI_EVENT_FEATURE

endmenu
```

## drivers/tchip/Kconfig
```kconfig
menu "T-Chip Products Configuration"

#########################################
#           T-Chip Series Boards        #
menu "T-Chip USB info Select"

config TCHIP_USB_VENDOR
	string "USB Controller Vendor"
	default "T-Chip"
	help
		Changes according to the requirements of your product.

config TCHIP_USB_PRODUCT
	string "USB Controller Product"
	default "T-Chip"
	help
		Changes according to the requirements of your product.

config TCHIP_USB_INFO
	string "USB Information"
	default "T-Chip USB Device"
	help
		Changes according to the requirements of your product.
	
endmenu

#########################################
#           T-Chip Series Boards        #
choice
	prompt "Select Machine Model"
	default TCHIP_MACH_DEFAULT


	config TCHIP_MACH_DEFAULT

		bool "Unknow tchip RK30 Machine"
	
    config TCHIP_MACH_TR1088
		bool "TR1088, Public 10.1' Machine"
		
	config TCHIP_MACH_TR7888
		bool "TR7888, Public 7.85' Machine"
		
	config TCHIP_MACH_TR8088
		bool "TR8088, Public 8' Machine"
    
    config TCHIP_MACH_TR7078
		bool "TR7078, Public 7' Machine"
    
    config TCHIP_MACH_TR7078IPS_SAMSUNG
		depends on TCHIP_MACH_TR7078
		bool "TR7078, Public 7' SAMSUNG IPS Screen Machine"
    
    config TCHIP_MACH_TR7078IPS_BOE
		depends on TCHIP_MACH_TR7078
		bool "TR7078, Public 7' BOE IPS Screen Machine"
    
    config TCHIP_MACH_TR7088
		bool "TR7088, Public 7' Machine"

    config TCHIP_MACH_TR7088TN
		depends on TCHIP_MACH_TR7088
		bool "TR7088, Public 7' TNscreen Machine"

    config TCHIP_MACH_TR7088_CUBE
		depends on TCHIP_MACH_TR7088
		bool "TR7088, Public 7' TNscreen Machine for CUBE"

	config TCHIP_MACH_TR785
		bool "TR785, Public 7.85' Machine"
		select TCHIP_MACHINE

	config TCHIP_MACH_TR785_V10
		depends on TCHIP_MACH_TR785
		bool "v10 for tr785"
	
	config TCHIP_MACH_TR785_V20
		depends on TCHIP_MACH_TR785
		bool "v01 for tr785"
		
    config TCHIP_MACH_TR838D
		bool "TR838(3168), 8' Machine for KangGuan"

    config TCHIP_MACH_TR838
		bool "TR838(3188), 8' Machine for KangGuan"
       
	config TCHIP_MACH_TRQ7
		bool "TRQ7, PLDT product, and select the follow Customer"
		
    config TCHIP_MACH_XBT_3188
		bool "XBT(3188), 9'76 Machine for XBT"

endchoice

choice 
	prompt "Select TRQ7 for AoRan or LingJu"
	depends on TCHIP_MACH_TRQ7
	default TCHIP_MACH_TRQ7_AR

	config TCHIP_MACH_TRQ7_AR
		bool "TRQ7 for AoRan"

	config TCHIP_MACH_TRQ7_LJ
		bool "TRQ7 for LingJu"

endchoice


#########################################
#           T-Chip Series Boards        #
choice
	prompt "Select Customer for your Machine model"
	default TCHIP_MACH_DEFAUL

	config TCHIP_MACH_DEFAUL
		bool "have no Customer now"

	config TCHIP_CUSTOMER_KangGuan
		bool "Kang Guan"

	config TCHIP_CUSTOMER_Soaiy
		bool "Soaiy"
		select LOGO_LINUX_CLUT224_SOAIY

endchoice

menu "T-Chip Products Tool adapt IC Select"
choice
        prompt "Camera Support"
            default TCHIP_MACH_DOUBLE_CAMEAR

       config TCHIP_MACH_SINGLE_FRONT_CAMERA
               bool "Only support front camera"

       config TCHIP_MACH_SINGLE_BACK_CAMERA
               bool "Only support back camera"

        config TCHIP_MACH_DOUBLE_CAMEAR
               bool "support double camera"
endchoice

choice
	prompt "T-Chip Products Tool adapt Hdmi IC Select"
	#default TCHIP_MACH_NOHDMI
	
	config TCHIP_MACH_ANX7150
	    depends on ANX7150
		bool "ANX7150 is open"

	config TCHIP_MACH_CAT6611
	    depends on CAT6611
		bool "CAT6611 is open"
		
	config TCHIP_MACH_HDMI_RK30
	    depends on HDMI_RK30
		bool "RK30 HDMI is open"
		
	config TCHIP_MACH_HDMI_RK610
	    depends on HDMI_RK610
		bool "RK610 HDMI is open"
		
	config TCHIP_MACH_HDMI_RK616
	    depends on HDMI_RK616
		bool "RK616 HDMI is open"

	config TCHIP_MACH_NOHDMI
		bool "No HDMI"
endchoice

choice
	prompt "T-Chip Products Tool adapt Wifi IC Select"
	default TCHIP_MACH_NOWIFI
	
	config TCHIP_MACH_AR6003
	    depends on AR6003
		bool "AR6003 is open"

	config TCHIP_MACH_BCM4329
	    depends on BCM4329
		bool "BCM4329 is open"

	config TCHIP_MACH_MV8686
	    depends on MV8686
		bool "MV8686 is open"

	config TCHIP_MACH_RTL8192
	    depends on RTL8192CU
		bool "RTL8192 is open"
		
	config TCHIP_MACH_NOWIFI
		bool "No Wifi"
endchoice

choice
	prompt "T-Chip Products Tool adapt Codec IC Select"
	default TCHIP_MACH_SND_RK29_SOC_WM8988
	
	config TCHIP_MACH_SND_RK29_SOC_WM8988
	    depends on SND_RK29_SOC_WM8988
		bool "WM8988 is open"
		
	config TCHIP_MACH_SND_RK29_SOC_WM8900
	    depends on SND_RK29_SOC_WM8900
		bool "WM8900 is open"

	config TCHIP_MACH_SND_RK29_SOC_RT5621
	    depends on SND_RK29_SOC_RT5621
		bool "RT5621 is open"

	config TCHIP_MACH_SND_RK29_SOC_WM8994
		depends on SND_RK29_SOC_WM8994
		bool "WM8994 is open"
		
	config TCHIP_MACH_SND_RK29_SOC_RT5631
	    depends on SND_RK29_SOC_RT5631
		bool "RT5631 is open"		

	config TCHIP_MACH_SND_RK29_SOC_RK610
	    depends on SND_RK29_SOC_RK610
		bool "RK610 is open"	
		
	config TCHIP_MACH_SND_RK_SOC_RK616
	    depends on SND_RK_SOC_RK616
		bool "RK616 is open"
		
	config TCHIP_MACH_SND_RK29_SOC_ES8323
	    depends on SND_RK29_SOC_ES8323
		bool "ES8323 is open"	
			
endchoice

choice
	prompt  "T-Chip Products Tool adapt Touch IC Select"
	default TCHIP_MACH_TOUCH_GSL3680

	config TCHIP_MACH_TOUCH_GSL3680
		bool "GSL3680 is open"
		depends on TOUCHSCREEN_GSLX680
	
endchoice

choice
	prompt  "T-Chip Products Tool adapt Modem IC Select"
	default TCHIP_MACH_MODEM_OTHERS

	config TCHIP_MACH_MODEM_OTHERS
		bool "ROCKCHIP modem is open"
		depends on MODEM_ROCKCHIP_DEMO

	config TCHIP_MACH_MODEM_TDM330
		bool "TDM330 is open"
		depends on TDM330
endchoice

   config TCHIP_RK29_GPS
		bool "T-CHIP GPS is open"
	        depends on RK29_GPS
	        default n

endmenu
#caixx add end 

#############################3 
#add tchip function
#############################
config TCHIP_MIX_HDMD
       default n
       bool "Tchip Machine Mix HD and MD Reselution "
       ---help---
         Define HD or MD Machine Reselution by add [tchip_resolution=HD/MD] in parameter file.

#########################################
#           T-Chip Series Boards        #
choice
	prompt  "T-Chip Display Rotation Select"
	default TCHIP_LOGO_ROTATE_0

config TCHIP_LOGO_ROTATE_0
    bool "Rotate LOGO 0"

config TCHIP_LOGO_ROTATE_180
    bool "Rotate LOGO 180"

config TCHIP_LOGO_ROTATE_90
	depends on LOGO_LINUX_CLUT224
    bool "Rotate LOGO 90,"

config TCHIP_LOGO_ROTATE_270
    bool "Rotate LOGO 270,"	
    depends on LOGO_LINUX_CLUT224

endchoice


endmenu
```
